#define VERSION_MACRO
macro_ver: macro_ver {
compatible = "zmk,behavior-macro";
label = "macro_ver";
#binding-cells = <0>;
bindings = <&kp N2>, <&kp N0>, <&kp N2>, <&kp N4>, <&kp N0>, <&kp N5>, <&kp N0>, <&kp N8>, <&kp MINUS>, <&kp M>, <&kp A>, <&kp S>, <&kp T>, <&kp MINUS>, <&kp N1>, <&kp N5>, <&kp N0>, <&kp N3>, <&kp N3>, <&kp N0>, <&kp C>, <&kp RET>;
};
